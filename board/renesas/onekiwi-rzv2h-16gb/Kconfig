## board/renesas/onekiwi-rzv2h-16gb/Kconfig
```kconfig
if TARGET_ONEKIWI_RZV2H_16GB

config SYS_SOC
	default "rmobile"

config SYS_BOARD
	default "onekiwi-rzv2h-16gb"

config SYS_VENDOR
	default "renesas"

config SYS_CONFIG_NAME
	default "onekiwi-rzv2h-16gb"

endif
```

## board/renesas/onekiwi-rzv2h-8gb/Kconfig
```kconfig
if TARGET_ONEKIWI_RZV2H_8GB

config SYS_SOC
	default "renesas"

config SYS_BOARD
	default "onekiwi-rzv2h-8gb"

config SYS_VENDOR
	default "renesas"

config SYS_CONFIG_NAME
	default "onekiwi-rzv2h-8gb"

endif
```

## board/renesas/onekiwi-rzv2h-dev/Kconfig
```kconfig
if TARGET_ONEKIWI_RZV2H_DEV

config SYS_SOC
	default "rmobile"

config SYS_BOARD
	default "onekiwi-rzv2h-dev"

config SYS_VENDOR
	default "renesas"

config SYS_CONFIG_NAME
	default "onekiwi-rzv2h-dev"

endif
```
